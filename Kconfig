## Kconfig
```kconfig
config EYELASH_PERIPHERAL_STATUS_SCREEN
    bool "Tela custom do periferico (nome fixo + bateria) no OLED da metade"
    default n
    help
      Quando habilitado, fornece um custom status screen para as metades
      (perifericos) que mostra um texto fixo (CONFIG_EYELASH_PERIPHERAL_NAME)
      e o percentual de bateria, no lugar da animacao do nice_oled.
      Requer CONFIG_ZMK_DISPLAY_STATUS_SCREEN_CUSTOM=y na mesma build.

config EYELASH_PERIPHERAL_NAME
    string "Texto fixo mostrado no OLED desta metade"
    default "Sofle"
    depends on EYELASH_PERIPHERAL_STATUS_SCREEN
```

## config/west.yml
```yaml
manifest:
  remotes:
    - name: zmkfirmware
      url-base: https://github.com/zmkfirmware
    - name: mctechnology17
      url-base: https://github.com/mctechnology17
    - name: cormoran
      url-base: https://github.com/cormoran
    - name: englmaxi
      url-base: https://github.com/englmaxi
  projects:
    # ZMK base = mesmo fork do projeto zmk-sofle-oled (suporte DYA Studio)
    - name: zmk
      remote: cormoran
      revision: v0.3-branch+dya
      import: app/west.yml
    # Modulos DYA (cormoran) — necessarios pro keymap e relay de estado pros perifericos
    - name: zmk-behavior-runtime-sensor-rotate
      remote: cormoran
      revision: main
    - name: zmk-module-ble-management
      remote: cormoran
      revision: zmk-v0.3.0.0
    - name: zmk-module-battery-history
      remote: cormoran
      revision: main
    - name: zmk-module-settings-rpc
      remote: cormoran
      revision: main
    - name: zmk-module-runtime-input-processor
      remote: cormoran
      revision: zmk-v0.3.0.0
    # OLED das metades (mesmo modulo do projeto oled)
    - name: zmk-nice-oled
      remote: mctechnology17
      revision: main
    # OLED do dongle (central)
    - name: zmk-dongle-display
      remote: englmaxi
      revision: v0.3
  self:
    path: config
```
